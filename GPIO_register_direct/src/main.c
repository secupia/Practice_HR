/**
******************************************************************************
  - File:     main.c
  - Info:     Generated by Atollic TrueSTUDIO(R) 9.0.1   2020-12-18

  - Target Board : STM32-BSKO V2.0
  - Action : PB6 ON/OFF toggle
  - Register director control method

******************************************************************************
*/

/* Includes */
#include <stddef.h>
#include "stm32f10x.h"


#define GPIOB_CRL        (*(volatile unsigned int*)0x40010C00)    // GPIOB BIT0 - BIT7
#define GPIOB_CRH        (*(volatile unsigned int*)0x40010C04)    // GPIOB BIT8 - BIT15
#define GPIOB_IDR        (*(volatile unsigned int*)0x40010C08)    // GPIOB
#define GPIOB_ODR        (*(volatile unsigned int*)0x40010C0C)    // GPIOB
#define GPIOB_BSRR       (*(volatile unsigned int*)0x40010C10)    // GPIOB
#define GPIOB_BRR        (*(volatile unsigned int*)0x40010C14)    // GPIOB

#define RCC_APB2ENR      (*(volatile unsigned int*)0x40021018)    // BIT3: Port B clock enable

//#define REG_DIRECT

void delay(void)
{
    volatile unsigned int i, j;

    for(i = 0; i < 1000; i++)
    {
        for(j = 0; j < 1000; j++)
        {
            asm volatile("NOP");
        }
    }
}

int main(void)
{
#if defined (REG_DIRECT)
  RCC_APB2ENR |= 0x00000008;                      // Bit3 IOPBEN : IO Port B clock enable
  GPIOB_CRL   |= (0x10000000 | 0x01000000);       // PB7,6 Output PP, 10MHz
#else
  SET_BIT(RCC->APB2ENR, RCC_APB2ENR_IOPBEN);
  SET_BIT(GPIOB->CRL,GPIO_CRL_MODE7_0|GPIO_CRL_MODE6_0);
#endif


  while (1)
  {
#if defined (REG_DIRECT)
      GPIOB_ODR |= (0x00000040 | 0x00000080);     // PB6 -- LED1, PB7 -- LED2 OFF
      delay();
      GPIOB_ODR &= ~(0x00000040 | 0x00000080);    // PB6 -- LED1, PB7 -- LED2 On
      delay();
#else
      SET_BIT(GPIOB->ODR, GPIO_ODR_ODR6|GPIO_ODR_ODR7);
      delay();
      CLEAR_BIT(GPIOB->ODR, GPIO_ODR_ODR6|GPIO_ODR_ODR7);
      delay();
#endif
  }
}

